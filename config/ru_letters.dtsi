// from zmk-locales
#include <locale/keys_ru.h>
/*Russian letters*/
#define RU_(NAME) RU_CYRILLIC_ ## NAME
/* а = RU_CYRILLIC_A          -> HID_USAGE_KEY_KEYBOARD_F*/
/* б = RU_CYRILLIC_BE         -> HID_USAGE_KEY_KEYBOARD_COMMA_AND_LESS_THAN*/
/* в = RU_CYRILLIC_VE         -> HID_USAGE_KEY_KEYBOARD_D*/
/* г = RU_CYRILLIC_GHE        -> HID_USAGE_KEY_KEYBOARD_U*/
/* д = RU_CYRILLIC_DE         -> HID_USAGE_KEY_KEYBOARD_L*/
/* е = RU_CYRILLIC_IE         -> HID_USAGE_KEY_KEYBOARD_T*/
/* ё = RU_CYRILLIC_IO         -> HID_USAGE_KEY_KEYBOARD_GRAVE_ACCENT_AND_TILDE*/
/* ж = RU_CYRILLIC_ZHE        -> HID_USAGE_KEY_KEYBOARD_SEMICOLON_AND_COLON*/
/* з = RU_CYRILLIC_ZE         -> HID_USAGE_KEY_KEYBOARD_P*/
/* и = RU_CYRILLIC_I          -> HID_USAGE_KEY_KEYBOARD_B*/
/* й = RU_CYRILLIC_SHORT_I    -> HID_USAGE_KEY_KEYBOARD_Q*/
/* к = RU_CYRILLIC_KA         -> HID_USAGE_KEY_KEYBOARD_R*/
/* л = RU_CYRILLIC_EL         -> HID_USAGE_KEY_KEYBOARD_K*/
/* м = RU_CYRILLIC_EM         -> HID_USAGE_KEY_KEYBOARD_V*/
/* н = RU_CYRILLIC_EN         -> HID_USAGE_KEY_KEYBOARD_Y*/
/* о = RU_CYRILLIC_O          -> HID_USAGE_KEY_KEYBOARD_J*/
/* п = RU_CYRILLIC_PE         -> HID_USAGE_KEY_KEYBOARD_G*/
/* р = RU_CYRILLIC_ER         -> HID_USAGE_KEY_KEYBOARD_H*/
/* с = RU_CYRILLIC_ES         -> HID_USAGE_KEY_KEYBOARD_C*/
/* т = RU_CYRILLIC_TE         -> HID_USAGE_KEY_KEYBOARD_N*/
/* у = RU_CYRILLIC_U          -> HID_USAGE_KEY_KEYBOARD_E*/
/* ф = RU_CYRILLIC_EF         -> HID_USAGE_KEY_KEYBOARD_A*/
/* х = RU_CYRILLIC_HA         -> HID_USAGE_KEY_KEYBOARD_LEFT_BRACKET_AND_LEFT_BRACE*/
/* ц = RU_CYRILLIC_TSE        -> HID_USAGE_KEY_KEYBOARD_W*/
/* ч = RU_CYRILLIC_CHE        -> HID_USAGE_KEY_KEYBOARD_X*/
/* ш = RU_CYRILLIC_SHA        -> HID_USAGE_KEY_KEYBOARD_I*/
/* щ = RU_CYRILLIC_SHCHA      -> HID_USAGE_KEY_KEYBOARD_O*/
/* ь = RU_CYRILLIC_SOFT_SIGN  -> HID_USAGE_KEY_KEYBOARD_M*/
/* ы = RU_CYRILLIC_YERU       -> HID_USAGE_KEY_KEYBOARD_S*/
/* ъ = RU_CYRILLIC_HARD_SIGN  -> HID_USAGE_KEY_KEYBOARD_RIGHT_BRACKET_AND_RIGHT_BRACE*/
/* э = RU_CYRILLIC_E          -> HID_USAGE_KEY_KEYBOARD_APOSTROPHE_AND_QUOTE*/
/* ю = RU_CYRILLIC_YU         -> HID_USAGE_KEY_KEYBOARD_PERIOD_AND_GREATER_THAN*/
/* я = RU_CYRILLIC_YA         -> HID_USAGE_KEY_KEYBOARD_Z*/

/* vim: set ft=c tw=180: */
