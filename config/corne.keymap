#include <behaviors.dtsi>
#include <behaviors/num_word.dtsi> // requires auto-layer module
#include <dt-bindings/zmk/keys.h>
#include <dt-bindings/zmk/bt.h>
#include <dt-bindings/zmk/outputs.h>

// unicode sequence = LINUX
/*#define HOST_OS 1*/
#include "zmk-helpers/helper.h"
// Source desired key-position labels
#include "zmk-helpers/key-labels/42.h"
// Source unicode-chars for desired languages
/*#include "zmk-helpers/unicode-chars/russian.dtsi"*/
// Greek chars
/*#include "zmk-helpers/unicode-chars/greek.dtsi"*/

#include "ru_letters.dtsi"

#define DEF 0
#define RUS 1
#define NAV 2
#define FN 3
#define NUM 4
#define SYM 5
#define SYS 6
#define MOUSE 7

#define XXX &none
#define ___ &trans

/* Global settings */
#define TAPPING_TERM_MS 280
#define QUICK_TAP_MS 175
#define REQUIRE_PRIOR_IDLE_MS 150

&sk {  // sticky-key config
    release-after-ms = <900>;  // release after 0.9s
    quick-release;             // no double capitalization when rolling keys
};

&sl {  // sticky-layer config
    ignore-modifiers;          // allow chording sticky mods & layers
};

&lt {  // layer-tap config
    flavor = "balanced";
    tapping-term-ms = <200>;
    quick-tap-ms = <QUICK_TAP_MS>;
};

&key_repeat { // repeat config
    usage-pages = <HID_USAGE_KEY HID_USAGE_CONSUMER>;
};

/* Homerow mods */

#define KEYS_L LT0 LT1 LT2 LT3 LT4 LT5 LM0 LM1 LM2 LM3 LM4 LM5 LB0 LB1 LB2 LB3 LB4 LB5  // left hand
#define KEYS_R RT0 RT1 RT2 RT3 RT4 RT5 RM0 RM1 RM2 RM3 RM4 RM5 RB0 RB1 RB2 RB3 RB4 RB5  // right hand
#define THUMBS LH2 LH1 LH0 RH0 RH1 RH2                                                  // thumbs

#define MAKE_HRM(NAME, HOLD, TAP, TRIGGER_POS) \
    ZMK_HOLD_TAP(NAME, \
        flavor = "balanced"; \
        tapping-term-ms = <TAPPING_TERM_MS>; \
        quick-tap-ms = <QUICK_TAP_MS>; \
        require-prior-idle-ms = <REQUIRE_PRIOR_IDLE_MS>; \
        bindings = <HOLD>, <TAP>; \
        hold-trigger-key-positions = <TRIGGER_POS>; \
        hold-trigger-on-release; \
    )
MAKE_HRM(hml, &kp, &kp, KEYS_R THUMBS)  // left-hand HRMs
MAKE_HRM(hmr, &kp, &kp, KEYS_L THUMBS)  // right-hand HRMs

MAKE_HRM(m_hml, &kp, &m_shkey, KEYS_R THUMBS)  // left-hand HRMs
MAKE_HRM(m_hmr, &kp, &m_shkey, KEYS_L THUMBS)  // right-hand HRMs

// HRM combo hack - workaround for lack of tap-only combos (ZMK issue #544)
#define ZMK_COMBO_8(NAME, TAP, KEYPOS, LAYERS, COMBO_TERM, COMBO_IDLE, HOLD, SIDE) \
    MAKE_HRM(hm_combo_ ## NAME, &kp, TAP, SIDE THUMBS) \
    ZMK_COMBO_6(NAME, &hm_combo_ ## NAME HOLD 0, KEYPOS, LAYERS, COMBO_TERM, COMBO_IDLE)

/* Combos, leader key sequences, mouse emulation */

#include "combos.dtsi"  // must be sources after HRM-combo hack
#include "leader.dtsi"
#include "mouse.dtsi"
#include "macros.dtsi"

/* Nav cluster */

// long-tap action on hold, short-tap action on all interrupts
#define MT_CORE \
    flavor = "tap-preferred"; \
    tapping-term-ms = <220>; \
    quick-tap-ms = <220>; \
    hold-trigger-key-positions = <0>;

&mt { MT_CORE };

#define NAV_LEFT  &mt_home 0   LEFT    // tap: left  | long-tap: beginning of line
#define NAV_RIGHT &mt_end 0    RIGHT   // tap: right | long-tap: end       of line
#define NAV_UP    &mt LC(HOME) UP      // tap: up    | long-tap: beginning of document
#define NAV_DOWN  &mt LC(END)  DOWN    // tap: down  | long-tap: end       of document
#define NAV_BSPC  &mt LC(BSPC) BSPC    // tap: bspc  | long-tap: delete word backward
#define NAV_DEL   &mt LC(DEL)  DEL     // tap: del   | long-tap: delete word forward

// mask CTRL when holding left/right to avoid accidental jumps to beginning/end of document
#define MASK_MODS(NAME, MODS, BINDING) \
    ZMK_MOD_MORPH(NAME, \
        bindings = <BINDING>, <BINDING>; \
        mods = <MODS>; \
    )
MASK_MODS(masked_home, (MOD_LCTL), &kp HOME)
MASK_MODS(masked_end,  (MOD_LCTL), &kp END)

ZMK_HOLD_TAP(mt_home, bindings = <&masked_home>, <&kp>; MT_CORE)
ZMK_HOLD_TAP(mt_end, bindings = <&masked_end>, <&kp>; MT_CORE)

/* Caps-word, num-word and smart-mouse */

// tap: sticky-shift | shift + tap/ double-tap: caps-word | hold: shift
ZMK_MOD_MORPH(smart_shft,
    bindings = <&sk LSHFT>, <&caps_word>;
    mods = <(MOD_LSFT)>;
)

&caps_word {  // mods deactivate caps-word, requires PR #1451
    /delete-property/ ignore-modifiers;
};

/*&num_word { // num_word config*/
/*    continue-list = <BSPC DEL DOT COMMA>;*/
/*    ignore-modifiers;          // allow chording sticky mods & layers*/
/*};*/

// tap: num-word | double-tap: sticky num-layer | hold: num-layer
#define SMART_NUM &smart_num NUM 0
ZMK_HOLD_TAP(smart_num,
    flavor = "balanced";
    tapping-term-ms = <200>;
    quick-tap-ms = <QUICK_TAP_MS>;
    bindings = <&mo>, <&num_dance>;
)
ZMK_TAP_DANCE(num_dance,
    tapping-term-ms = <200>;
    bindings = <&num_word NUM>, <&sl NUM>;  // reverse this for sticky-num on single tap
)

// smart-mouse, requires PR #1366
ZMK_TRI_STATE(smart_mouse,
    bindings = <&tog MOUSE>, <&none>, <&tog MOUSE>;
    ignored-key-positions = <LT1 LT3 LM1 LM2 LM3 LM4 RT0 RT1 RT2 RT3 RT4 RM0 RM1 RM2 RM3 RM4 RB0 RB1 RB2 RB3 RB4 RH0 RH1>;
    ignored-layers = <MOUSE>;
)

/* Custom behaviors */

// Alt+Tab swapper, requires PR #1366
ZMK_TRI_STATE(swapper,
    bindings = <&kt LALT>, <&kp TAB>, <&kt LALT>;
    ignored-key-positions = <LT2 LT3>;
)

// Alt+GRAVE swapper_alt, requires PR #1366
ZMK_TRI_STATE(swapper_alt,
    bindings = <&kt LALT>, <&kp GRAVE>, <&kt LALT>;
    ignored-key-positions = <LT2 LT3>;
)

// reuse basic mod-morph scheme
#define SIMPLE_MORPH(NAME, MOD, BINDING1, BINDING2) \
    ZMK_MOD_MORPH(NAME, \
        mods = <(MOD_L ## MOD|MOD_R ## MOD)>; \
        bindings = <BINDING1>, <BINDING2>; \
    )

// tap: comma[,] | shift + tap: semicolon[;] | ctrl + shift + tap: [<]
SIMPLE_MORPH(comma_morph, SFT, &kp COMMA, &comma_inner_morph)
SIMPLE_MORPH(comma_inner_morph, CTL, &kp SEMICOLON, &kp LESS_THAN)

// tap: dot[.] | shift + tap: colon[:] | ctrl + shift + tap: [>]
SIMPLE_MORPH(dot_morph, SFT, &kp DOT, &dot_inner_morph)
SIMPLE_MORPH(dot_inner_morph, CTL, &kp COLON, &kp GREATER_THAN)

// tap: qmark[?] | shift + tap: excl[!]
SIMPLE_MORPH(qexcl, SFT, &kp QMARK, &kp EXCL)

// tap: left[(]/right[)] parenthesis | shft + tap: less-than[<]/greater-than[>]
SIMPLE_MORPH(lpar_lt, SFT, &kp LPAR, &kp LT)
SIMPLE_MORPH(rpar_gt, SFT, &kp RPAR, &kp GT)

// tap: space | shift + tap: dot -> space -> sticky shift | hold: activate layer
ZMK_HOLD_TAP(lt_spc,
    flavor = "balanced";
    tapping-term-ms = <200>;
    quick-tap-ms = <QUICK_TAP_MS>;
    bindings = <&mo>, <&spc_morph>;
)
SIMPLE_MORPH(spc_morph, SFT, &kp SPACE, &dot_spc)
ZMK_MACRO(dot_spc,
    wait-ms = <0>;
    tap-ms = <5>;
    bindings = <&kp DOT &kp SPACE &sk LSHFT>;
)

// tap: backspace | lshft + tap: delete | rshft + tap: shift-delete
ZMK_MOD_MORPH(bs_del,
    bindings = <&kp BSPC>, <&kp DEL>;
    mods = <(MOD_LSFT|MOD_RSFT)>;
    keep-mods = <MOD_RSFT>;
)

// tap: copy | double-tap: cut
ZMK_TAP_DANCE(copy_cut,
    tapping-term-ms = <200>;
    bindings = <&kp LC(INS)>, <&kp LC(X)>;
)

// Sticky shift + leader
/*ZMK_MACRO(leader_sft, bindings = <&sk LSHFT &leader>;)*/

// misc aliases
#define CANCEL      &kp K_CANCEL             // cancel caps-word, num-word and smart-mouse
#define DSK_PREV    &hmr LCTRL LG(LA(LEFT))  // previous desktop
#define DSK_NEXT    &hmr LALT LG(LA(RIGHT))  // next     desktop
#define PIN_WIN     &kp LG(LC(LS(Q)))        // pin window across desktops
#define PIN_APP     &kp LG(LC(LS(A)))        // pin application across desktops
#define DSK_MGR     &kp LA(GRAVE)            // desktop manager
#define VOL_DOWN    &hmr RSHFT C_VOL_DN
#define KEY_C_PP    &hmr RGUI C_PP

// tap: macro Win+SPACE &tog RUS | lshft/rshft + tap: toggle RUS layour 
ZMK_MOD_MORPH(rus_toggle,
    bindings = <&lang_macro>, <&tog RUS>;
    mods = <(MOD_LSFT|MOD_RSFT)>;
)
// Macro for Russian layer toggle (my DIKTOR version layout)
// Win+SPACE &tog RUS
ZMK_MACRO(lang_macro,
    wait-ms = <2>;
    tap-ms = <5>;
    bindings = <&kp LG(SPACE) &tog RUS>;
)

/*ZMK_KEY_REPEAT(my_repeat)*/
/* Keymap */

ZMK_CONDITIONAL_LAYER(sys, FN NUM, SYS)  // FN + NUM --> SYS

ZMK_LAYER(def,
//╭───────────┬─────────────┬─────────────┬───────────────┬──────────────┬─────────────╮╭─────────────┬──────────────┬───────────────┬─────────────┬──────────────┬───────────╮
    &rus_toggle &kp B         &kp L         &kp D           &kp W          &kp Z          &kp J         &kp F          &kp O           &kp U         &kp SQT        &kp BSLH
//├───────────┼─────────────┼─────────────┼───────────────┼──────────────┼─────────────┤├─────────────┼──────────────┼───────────────┼─────────────┼──────────────┼───────────┤
    &kp TAB     &hml LGUI N   &hml LALT R   &hml LSHFT T    &hml LCTRL S   &kp G          &kp Y         &hmr RCTRL H   &hmr RSHFT A    &hmr RALT E   &hmr RGUI I    &key_repeat
//├───────────┼─────────────┼─────────────┼───────────────┼──────────────┼─────────────┤├─────────────┼──────────────┼───────────────┼─────────────┼──────────────┼───────────┤
    &tog SYM    &kp Q         &kp X         &kp M           &kp C          &kp V          &kp K         &kp P          &comma_morph    &dot_morph    &qexcl         &kp ESC
//╰───────────┴─────────────┴─────────────┼───────────────┼──────────────┼─────────────┤├─────────────┼──────────────┼───────────────┼─────────────┴──────────────┴───────────╯
                                            &bs_del         &lt_spc NAV 0  &lt FN RET     SMART_NUM     &smart_shft    &smart_mouse
//                                        ╰───────────────┴──────────────┴─────────────╯╰─────────────┴──────────────┴───────────────╯
)

ZMK_LAYER(rus,
//╭───────────┬────────────────┬─────────────────┬───────────────────┬─────────────────┬───────────────╮╭───────────────┬──────────────────┬───────────────────┬─────────────────┬──────────────────┬──────────────╮
    ___        &kp RU_(HARD_SIGN) &kp RU_(YERU)    &kp RU_(A)          &kp RU_(YA)       &kp RU_(EF)      &kp RU_(ZE)     &kp RU_(VE)        &kp RU_(KA)         &kp RU_(DE)       &kp RU_(CHE)       &kp RU_(SHCHA)
//├───────────┼────────────────┼─────────────────┼───────────────────┼─────────────────┼───────────────┤├───────────────┼──────────────────┼───────────────────┼─────────────────┼──────────────────┼──────────────┤
    ___         &hml LGUI RU_(U) &hml LALT RU_(I)  &hml LSHFT RU_(IE)  &hml LCTRL RU_(O) &kp RU_(HA)      &kp RU_(EL)     &hmr RCTRL RU_(EN) &hmr RSHFT RU_(TE)  &hmr RALT RU_(ES) &hmr RGUI RU_(ER)  &kp RU_(SHA)
//├───────────┼────────────────┼─────────────────┼───────────────────┼─────────────────┼───────────────┤├───────────────┼──────────────────┼───────────────────┼─────────────────┼──────────────────┼──────────────┤
    ___        &kp RU_(SOFT_SIGN) &kp RU_(SHORT_I) &kp RU_(E)          &kp RU_(YU)       &kp RU_(TSE)     &kp RU_(BE)     &kp RU_(EM)        &kp RU_(PE)         &kp RU_(GHE)      &kp RU_(ZHE)       &kp RU_(IO)
//╰───────────┴────────────────┴─────────────────┼───────────────────┼─────────────────┼───────────────┤├───────────────┼──────────────────┼───────────────────┼─────────────────┴──────────────────┴──────────────╯
                                                   ___                 ___               ___              ___             ___                ___
//                                               ╰───────────────────┴─────────────────┴───────────────╯╰───────────────┴──────────────────┴───────────────────╯
)

ZMK_LAYER(nav,
//╭───────────┬─────────────┬─────────────┬───────────────┬──────────────┬─────────────╮╭─────────────┬──────────────┬───────────────┬─────────────┬──────────────┬───────────╮
    ___         ___           &kp LS(GRAVE) &kp LS(TAB)     &swapper       &swapper_alt   &kp PG_UP     NAV_BSPC       NAV_UP          NAV_DEL       ___            ___
//├───────────┼─────────────┼─────────────┼───────────────┼──────────────┼─────────────┤├─────────────┼──────────────┼───────────────┼─────────────┼──────────────┼───────────┤
    &kp CLCK    &sk LGUI      &sk LALT      &sk LSHFT       &sk LCTRL      &kp ESC        &kp PG_DN     NAV_LEFT       NAV_DOWN        NAV_RIGHT     &kp RET        ___
//├───────────┼─────────────┼─────────────┼───────────────┼──────────────┼─────────────┤├─────────────┼──────────────┼───────────────┼─────────────┼──────────────┼───────────┤
    ___         ___           ___           ___             &key_repeat    ___            &kp INS       &kp TAB        &comma_morph    &dot_morph    &qexcl         ___
//╰───────────┴─────────────┴─────────────┼───────────────┼──────────────┼─────────────┤├─────────────┼──────────────┼───────────────┼─────────────┴──────────────┴───────────╯
                                            ___             ___            ___            &tog SYM      CANCEL         ___
//                                        ╰───────────────┴──────────────┴─────────────╯╰─────────────┴──────────────┴───────────────╯
)

ZMK_LAYER(fn,
//╭───────────┬─────────────┬─────────────┬───────────────┬──────────────┬─────────────╮╭─────────────┬──────────────┬───────────────┬─────────────┬──────────────┬───────────╮
    &kp PSCRN   &kp F12       &kp F7        &kp F8          &kp F9         ___            ___           &kp C_PREV     &kp C_VOL_UP    &kp C_NEXT    &kp C_MUTE     ___
//├───────────┼─────────────┼─────────────┼───────────────┼──────────────┼─────────────┤├─────────────┼──────────────┼───────────────┼─────────────┼──────────────┼───────────┤
    &kp SLCK    &hml LGUI F11 &hml LALT F4  &hml LSHFT F5   &hml LCTRL F6  ___            ___           DSK_PREV       VOL_DOWN        DSK_NEXT      KEY_C_PP       ___
//├───────────┼─────────────┼─────────────┼───────────────┼──────────────┼─────────────┤├─────────────┼──────────────┼───────────────┼─────────────┼──────────────┼───────────┤
 &kp PAUSE_BREAK &kp F10      &kp F1        &kp F2          &kp F3         ___            PIN_APP       PIN_WIN        DSK_MGR         ___           ___            ___
//╰───────────┴─────────────┴─────────────┼───────────────┼──────────────┼─────────────┤├─────────────┼──────────────┼───────────────┼─────────────┴──────────────┴───────────╯
                                            ___             ___            ___            ___           ___            ___
//                                        ╰───────────────┴──────────────┴─────────────╯╰─────────────┴──────────────┴───────────────╯
)

ZMK_LAYER(num,
//╭───────────┬─────────────┬─────────────┬───────────────┬──────────────┬─────────────╮╭─────────────┬──────────────┬───────────────┬─────────────┬──────────────┬───────────╮
    ___         ___           &kp N7        &kp N8          &kp N9         ___            ___           ___            ___             ___           ___            ___
//├───────────┼─────────────┼─────────────┼───────────────┼──────────────┼─────────────┤├─────────────┼──────────────┼───────────────┼─────────────┼──────────────┼───────────┤
    ___         &hml LGUI N0  &hml LALT N4  &hml LSHFT N5   &hml LCTRL N6  ___            ___           ___            ___             ___           ___            ___
//├───────────┼─────────────┼─────────────┼───────────────┼──────────────┼─────────────┤├─────────────┼──────────────┼───────────────┼─────────────┼──────────────┼───────────┤
    ___         ___           &kp N1        &kp N2          &kp N3         ___            ___           ___            ___             ___           ___            ___
//╰───────────┴─────────────┴─────────────┼───────────────┼──────────────┼─────────────┤├─────────────┼──────────────┼───────────────┼─────────────┴──────────────┴───────────╯
                                            ___             ___            ___            ___           ___            ___
//                                        ╰───────────────┴──────────────┴─────────────╯╰─────────────┴──────────────┴───────────────╯
)

ZMK_LAYER(sym,
//╭───────────┬─────────────┬─────────────┬───────────────┬──────────────┬─────────────╮╭─────────────┬──────────────┬───────────────┬─────────────┬──────────────┬───────────╮
    ___         &kp GRAVE     &kp CARET     &kp PRCNT       &kp AMPS       &kp PLUS       &kp PIPE      &kp LPAR       &kp RPAR        ___           ___            ___ 
//├───────────┼─────────────┼─────────────┼───────────────┼──────────────┼─────────────┤├─────────────┼──────────────┼───────────────┼─────────────┼──────────────┼───────────┤
    /*___         &kp DLLR      &kp AT        &kp LT          &kp GT         &kp EQUAL      &kp FSLH      &kp LBRC       &kp RBRC        &kp STAR      &kp HASH       ___     */
    ___    &m_hml LGUI N4 &m_hml LALT N2 &m_hml LSHFT COMMA &m_hml LCTRL DOT &kp EQUAL      &kp FSLH &m_hmr RCTRL LBKT &m_hmr RSHFT RBKT &m_hmr RALT N8 &m_hmr RGUI N3 ___     
//├───────────┼─────────────┼─────────────┼───────────────┼──────────────┼─────────────┤├─────────────┼──────────────┼───────────────┼─────────────┼──────────────┼───────────┤
    ___         &kp TILDE     &kp APOS      &qexcl          &kp UNDER      &kp MINUS      &kp BSLH      &kp LBKT       &kp RBKT        ___           ___            ___     
//╰───────────┴─────────────┴─────────────┼───────────────┼──────────────┼─────────────┤├─────────────┼──────────────┼───────────────┼─────────────┴──────────────┴───────────╯
                                            ___             ___            ___            &tog SYM      ___            ___
//                                        ╰───────────────┴──────────────┴─────────────╯╰─────────────┴──────────────┴───────────────╯
)

ZMK_LAYER(sys,
//╭───────────┬─────────────┬─────────────┬───────────────┬──────────────┬─────────────╮╭─────────────┬──────────────┬───────────────┬─────────────┬──────────────┬───────────╮
    &bt BT_CLR  ___           &out OUT_BLE  &out OUT_USB    ___            &bootloader    &bootloader   ___            ___             ___           ___            ___
//├───────────┼─────────────┼─────────────┼───────────────┼──────────────┼─────────────┤├─────────────┼──────────────┼───────────────┼─────────────┼──────────────┼───────────┤
    ___         ___           ___           ___             ___            &sys_reset     &sys_reset    ___            ___             ___           ___            ___
//├───────────┼─────────────┼─────────────┼───────────────┼──────────────┼─────────────┤├─────────────┼──────────────┼───────────────┼─────────────┼──────────────┼───────────┤
   &bt BT_SEL 0 &bt BT_SEL 1 &bt BT_SEL 2   &bt BT_SEL 3    &bt BT_SEL 4   ___            ___           ___            ___             ___           ___            ___
//╰───────────┴─────────────┴─────────────┼───────────────┼──────────────┼─────────────┤├─────────────┼──────────────┼───────────────┼─────────────┴──────────────┴───────────╯
                                            ___             ___            ___            ___           ___            ___
//                                        ╰───────────────┴──────────────┴─────────────╯╰─────────────┴──────────────┴───────────────╯
)

ZMK_LAYER(mouse,
//╭───────────┬─────────────┬─────────────┬───────────────┬──────────────┬─────────────╮╭─────────────┬──────────────┬───────────────┬─────────────┬──────────────┬───────────╮
    ___         ___           ___           ___             ___            ___            U_WH_U        &kp PG_UP      U_MS_U          &kp PG_DN     ___            ___
//├───────────┼─────────────┼─────────────┼───────────────┼──────────────┼─────────────┤├─────────────┼──────────────┼───────────────┼─────────────┼──────────────┼───────────┤
    ___         &sk LGUI      &sk LALT      &sk LSHFT       &sk LCTRL      ___            U_WH_L        U_MS_L         U_MS_D          U_MS_R        U_WH_R         ___
//├───────────┼─────────────┼─────────────┼───────────────┼──────────────┼─────────────┤├─────────────┼──────────────┼───────────────┼─────────────┼──────────────┼───────────┤
    ___         ___           ___           ___             ___            ___            U_WH_D        &mkp LCLK      &mkp MCLK       &mkp RCLK     &mkp LCLK      ___
//╰───────────┴─────────────┴─────────────┼───────────────┼──────────────┼─────────────┤├─────────────┼──────────────┼───────────────┼─────────────┴──────────────┴───────────╯
                                            ___             ___            ___            U_WH_U        U_WH_D         ___
//                                        ╰───────────────┴──────────────┴─────────────╯╰─────────────┴──────────────┴───────────────╯
)


/* vim: set ft=c tw=180: */

