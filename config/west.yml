## config/west.yml
```yaml
manifest:
  defaults:
    remote: urob
    revision: v0.1 # Pin everything to v0.1
  remotes:
    - name: zmkfirmware
      url-base: https://github.com/zmkfirmware
    # ZMK helper
    - name: urob
      url-base: https://github.com/urob
  projects:
    - name: zmk
      # remote: zmkfirmware
      remote: urob # try this insted zmkfirmware if build error
      revision: main
      # revision: v0.1+mouse # not patched??? build behavior issue with zmk-leader-key
      import: app/west.yml
    - name: zmk-helpers
      remote: urob
      revision: main
    - name: zmk-adaptive-key
      remote: urob
      revision: main
    - name: zmk-auto-layer
      remote: urob
      revision: main
    - name: zmk-leader-key
      remote: urob
      revision: main
      # revision: v0.1+locality
    - name: zmk-tri-state
      remote: urob
      revision: main
  self:
    path: config
```
